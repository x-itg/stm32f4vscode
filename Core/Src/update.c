
#include "update.h"
#include "eeprom.h"
static const unsigned char aucCRCHi[] = {
    0x00, 0xC1, 0x81, 0x40, 0x01, 0xC0, 0x80, 0x41, 0x01, 0xC0, 0x80, 0x41,
    0x00, 0xC1, 0x81, 0x40, 0x01, 0xC0, 0x80, 0x41, 0x00, 0xC1, 0x81, 0x40,
    0x00, 0xC1, 0x81, 0x40, 0x01, 0xC0, 0x80, 0x41, 0x01, 0xC0, 0x80, 0x41,
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    0x00, 0xC1, 0x81, 0x40};

static const unsigned char aucCRCLo[] = {
    0x00, 0xC0, 0xC1, 0x01, 0xC3, 0x03, 0x02, 0xC2, 0xC6, 0x06, 0x07, 0xC7,
    0x05, 0xC5, 0xC4, 0x04, 0xCC, 0x0C, 0x0D, 0xCD, 0x0F, 0xCF, 0xCE, 0x0E,
    0x0A, 0xCA, 0xCB, 0x0B, 0xC9, 0x09, 0x08, 0xC8, 0xD8, 0x18, 0x19, 0xD9,
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    0x41, 0x81, 0x80, 0x40};

unsigned char VersionChar[15] = "RB2303V1.011234";
unsigned char rsRxBuf[MAXU2MAX];
unsigned int rsRxLen = 0;
unsigned int rsRxTime = 0;
unsigned int rsRxIndex = 0;
unsigned char rsPackFlag = 0;
unsigned short part_num;             // 包数  如果这个值是4000表示 这个bin文件有500Kbytes： 4000x128=500Kbytes
unsigned short part_index;           // 包序号
unsigned short part_curIndexLen = 0; // 当前包长度  >=128

unsigned short CRC16x(unsigned char *pucFrame, unsigned short usLen)
{
    unsigned char ucCRCHi = 0xFF;
    unsigned char ucCRCLo = 0xFF;
    int iIndex;
    while (usLen--)
    {
        iIndex = ucCRCLo ^ *(pucFrame++);
        ucCRCLo = (unsigned char)(ucCRCHi ^ aucCRCHi[iIndex]);
        ucCRCHi = aucCRCLo[iIndex];
    }
    return (unsigned short)(ucCRCHi << 8 | ucCRCLo);
}
void appendCrcLH(unsigned char *ahead, unsigned short lens)
{
    unsigned short crc16tmpd = CRC16x(ahead, lens);
    *(ahead + lens + 0) = (crc16tmpd & 0x00ff) >> 0;
    *(ahead + lens + 1) = (crc16tmpd & 0xff00) >> 8;
}

unsigned char checkPackPro(unsigned char *rdata, unsigned short rlen)
{
    unsigned short pack_len = 0;
    unsigned short pack_crcLH0;
    unsigned short pack_crcLH1;
    unsigned int WriteAddress = 0;
    unsigned short writeLen = 0;
    pack_len = *(unsigned short *)&rdata[8];     // 长度校验
    if (pack_len > 528 || rlen != pack_len + 16) // 512+16=528
    {
        return 2; // 长度校验不通过
    }
    if (
        rdata[pack_len + 12] != 0xAB ||
        rdata[pack_len + 13] != 0xBC ||
        rdata[pack_len + 14] != 0xCD ||
        rdata[pack_len + 15] != 0xDE) // 结尾校验不通过
    {
        return 3; // 结尾校验不通过
    }
    pack_crcLH0 = *(unsigned short *)&rdata[pack_len + 10];
    pack_crcLH1 = CRC16x(rdata + 4, pack_len + 6);
    if (pack_crcLH0 != pack_crcLH1)
    {
        return 4; // 内容CRC校验不通过
    }
    else // 校验通过写入FLASH
    {
        part_num = *(unsigned short *)&rdata[4];         // 被拆分包的个数
        part_index = *(unsigned short *)&rdata[6];       // 包的序号
        part_curIndexLen = *(unsigned short *)&rdata[8]; // 当前序号包内容的字节数

        if (part_index == 0) // 第0个包擦除APP
        {
            FLASH_If_Init();              // 解锁
            while (FLASH_If_Erase() != 0) // 擦除
            {
                delay_ms(1);
            }
        }

        WriteAddress = 0x08010000 + (512 * part_index);                     // 写入地址
        writeLen = (part_curIndexLen) / 4 + (((part_curIndexLen) % 4) > 0); // 写入多少个4字节
        while (FLASH_If_Write(&WriteAddress, (uint32_t *)&rdata[10], writeLen) != 0)
        {
            delay_ms(1);
        }
        unsigned int why = EE_ReadWord(WriteAddress);
        if (part_num == part_index + 1) // 最后一包
        {
            FLASH_If_UnInit();  // 最后一包给FLASH上锁
            bootloaderflag = 3; // 升级完成
        }
        return 1;
    }
    return 0;
}
// 00 01 02 03 04 05 06 07 08 09 10 11 12 13 14 15 16 17
// A0 A1 A2 11 A0 A1 A2 A3      在bootloader中退出bootloader尝试进入app
// AA BB CC 11 AA BB CC DD      在app中重启再次进入bootloader后尝试升级
// AA BB CC 21 P_NUM P_IND P_LEN [128] C0 C1 AB BC CD DE      下发升级包  其中C0 和 C1 表示校验
// AA BB CC 21 P_NUM P_IND P_LEN C0 C1 AB BC CD DE            升级包应答  其中C0 和 C1 表示校验
// 升级包信息之P_NUM ：包的个数
// 升级包信息之P_IND ：这个数据包的内容
// 升级包信息之P_LEN ：这个数据包的长度
// 在上位机端收到的应答中升级包信息下发和应答一致则表示这个包已经成功写入设备Flash，上位机可以选择下发下一个数据包
// 在上位机端收到的应答中升级包信息下发和应答不一致的情况表示设备端校验出错，上位机端可以选择重传
// 在设备端 收P_IND为零的包时设备将会擦除APP所在flash扇区，
// 在设备端收到的最后一个数据包时（P_NUM=P_IND+1）设备端会给flash上锁退出bootloader尝试进入app
void exPool(void)
{
    if (rsPackFlag == 1 && rsRxTime > 30) // 断包 防止有些上位机软件发送数据不连续
    {
        rsPackFlag = 0;
        rsRxTime = 0;
        rsRxLen = rsRxIndex;
        rsRxIndex = 0;
        if ( // 进入boot   重启
            rsRxLen >= 14 &&
            rsRxBuf[0] == 0xAA &&
            rsRxBuf[1] == 0xBB &&
            rsRxBuf[2] == 0xCC &&
            rsRxBuf[3] == 0x011 &&
            rsRxBuf[14] == 0xAA &&
            rsRxBuf[15] == 0xBB &&
            rsRxBuf[16] == 0xCC &&
            rsRxBuf[17] == 0xDD)
        {
            memcpy(VersionChar, &rsRxBuf[4], 15);
            memcpy(&TxBufU2[0], &rsRxBuf[0], 18);
            HAL_UART_Transmit(&huart2, TxBufU2, 19, 20);
            __set_FAULTMASK(1); // 关闭所有中断
            NVIC_SystemReset(); // 复位
        }
        else if ( // 读取版本号
            rsRxLen >= 14 &&
            rsRxBuf[0] == 0xDD &&
            rsRxBuf[1] == 0xCC &&
            rsRxBuf[2] == 0xBB &&
            rsRxBuf[3] == 0x11)
        {
            memcpy(&TxBufU2[0], &rsRxBuf[0], 15);
            memcpy(&TxBufU2[4], VersionChar, 15);
            HAL_UART_Transmit(&huart2, TxBufU2, 19, 500);
        }
        else if (
            rsRxLen >= 16 &&
            rsRxBuf[0] == 0xAA &&
            rsRxBuf[1] == 0xBB &&
            rsRxBuf[2] == 0xCC &&
            rsRxBuf[3] == 0x21) // 升级包
        {

            unsigned short i;
            unsigned short rlen;
            i = 0;
            unsigned char retuc = checkPackPro(rsRxBuf, rsRxLen); // 保证数据正确再写入

            if (retuc == 1) // 校验通过 校验通过写入flash
            {
                rlen = part_curIndexLen; // rsRxBuf[8] rsRxBuf[9]
            }
            else
            {
                rlen = 0;
            }
            TxBufU2[i++] = 0xAA;
            TxBufU2[i++] = 0xBB;
            TxBufU2[i++] = 0xCC;
            TxBufU2[i++] = 0x21;
            TxBufU2[i++] = part_num >> 0;
            TxBufU2[i++] = part_num >> 8;
            TxBufU2[i++] = part_index >> 0;
            TxBufU2[i++] = part_index >> 8;
            TxBufU2[i++] = rlen >> 0;
            TxBufU2[i++] = rlen >> 8;
            appendCrcLH(TxBufU2 + 4, i - 4);
            i++;
            i++;
            TxBufU2[i++] = 0xAB;
            TxBufU2[i++] = 0xBC;
            TxBufU2[i++] = 0xCD;
            TxBufU2[i++] = 0xDE;

            HAL_UART_Transmit(&huart2, TxBufU2, i, 20);
        }
        HAL_UART_Receive_DMA(&huart2, RxBufU2, MAXU2MAX); // 再次开启DMA接收
    }
}